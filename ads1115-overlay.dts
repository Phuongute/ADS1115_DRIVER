/dts-v1/;
/plugin/;

/ {
    compatible = "brcm,bcm2835";

    fragment@0 {
        target = <&i2c1>;
        __overlay__ {
            #address-cells = <1>;
            #size-cells = <0>;

            ads1115@48 {
                compatible = "TI,ads1115";
                reg = <0x48>;  // Địa chỉ I2C
                status = "okay";
            };
        };
    };
};
